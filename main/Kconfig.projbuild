## main/Kconfig.projbuild
```kconfig
menu "espinel"

config ESPINEL_STACK_CHECK
    bool "Raise SystemStackError before the Ruby task's stack runs out"
    default y
    help
        Compile the generated C with -finstrument-functions so that every
        Ruby method checks the stack on entry and raises SystemStackError
        near its end (main/stack_check.c). Without it, a deep recursion runs
        past the stack into the heap silently. The check costs time: about
        a third on object-heavy code under QEMU, and more on small
        recursive methods, which it keeps GCC from optimizing.

config ESPINEL_TEST_MARKERS
    bool "Mark where the Ruby program's output starts and ends"
    default n
    help
        Print a line before the Ruby program starts and one with its exit
        status after it ends, for `rake test:qemu` to cut the program's
        output out of the boot log and to stop QEMU on. The test build turns
        it on (test/qemu/sdkconfig.defaults).

endmenu
```
